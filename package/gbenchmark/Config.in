## package/lua-nginx-module/Config.in
```kconfig
config BR2_PACKAGE_LUA_NGINX_MODULE
	bool "lua-nginx-module"
	help
	  Embed the power of Lua into Nginx HTTP Servers.

	  https://github.com/openresty/lua-nginx-module
```

## package/lua-resty-core/Config.in
```kconfig
config BR2_PACKAGE_LUA_RESTY_CORE
	bool "lua-resty-core"
	help
	  lua-resty-core - New FFI-based Lua API for ngx_http_lua_module and/or ngx_stream_lua_module

	  https://github.com/openresty/lua-resty-core
```

## package/lua-resty-lrucache/Config.in
```kconfig
config BR2_PACKAGE_LUA_RESTY_LRUCACHE
	bool "lua-resty-lrucache"
	help
	  lua-resty-lrucache - Lua-land LRU cache based on the LuaJIT FFI.

	  https://github.com/openresty/lua-resty-lrucache
```

## package/lua-resty-websocket/Config.in
```kconfig
config BR2_PACKAGE_LUA_RESTY_WEBSOCKET
	bool "lua-resty-websocket"
	help
	  lua-resty-websocket - Lua WebSocket implementation for the ngx_lua module.

	  https://github.com/openresty/lua-resty-websocket
```

## package/ngx-devel-kit/Config.in
```kconfig
config BR2_PACKAGE_NGX_DEVEL_KIT
	bool "ngx-devel-kit"
	help
	  ngx devel kit master.

	  https://github.com/vision5/ngx_devel_kit
```
