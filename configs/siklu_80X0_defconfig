## configs/siklu_80X0_defconfig
```kconfig
BR2_arm=y
BR2_cortex_a7=y
BR2_ARM_FPU_VFPV4=y
BR2_SVN="svn"
BR2_DL_DIR="${CACHE_ROOT_DIR}/cache/siklu/portf/80XX/buildroot-dl"
BR2_PRIMARY_SITE="${BUILDROOT_80XX_MIRROR}"
BR2_CCACHE=y
BR2_CCACHE_DIR="${CACHE_ROOT_DIR}/cache/siklu/portf/80XX/buildroot-ccache"
BR2_PER_PACKAGE_DIRECTORIES=y
BR2_SSP_NONE=y
BR2_TOOLCHAIN_BUILDROOT_GLIBC=y
BR2_KERNEL_HEADERS_CUSTOM_GIT=y
BR2_KERNEL_HEADERS_CUSTOM_REPO_URL="https://github.com/siklu/linux-nxp-branches"
BR2_KERNEL_HEADERS_CUSTOM_REPO_VERSION="portf-nxp-dsa-5.8.18"
BR2_PACKAGE_HOST_LINUX_HEADERS_CUSTOM_5_8=y
BR2_GCC_VERSION_11_X=y
BR2_TOOLCHAIN_BUILDROOT_CXX=y
BR2_TARGET_GENERIC_ROOT_PASSWD="123456"
BR2_TARGET_TZ_INFO=y
BR2_LINUX_KERNEL=y
BR2_LINUX_KERNEL_CUSTOM_GIT=y
BR2_LINUX_KERNEL_CUSTOM_REPO_URL="https://github.com/siklu/linux-nxp-branches"
BR2_LINUX_KERNEL_CUSTOM_REPO_VERSION="portf-nxp-dsa-5.8.18"
BR2_LINUX_KERNEL_DEFCONFIG="siklu_PCB277_V2"
BR2_LINUX_KERNEL_DTS_SUPPORT=y
BR2_LINUX_KERNEL_INTREE_DTS_NAME="imx6ull-14x14-siklu imx6ull-14x14-8012-siklu"
BR2_PACKAGE_BUSYBOX_SHOW_OTHERS=y
BR2_PACKAGE_BZIP2=y
BR2_PACKAGE_ZIP=y
BR2_PACKAGE_STRACE=y
BR2_PACKAGE_MTD=y
BR2_PACKAGE_MTD_MKFSUBIFS=y
BR2_PACKAGE_SQUASHFS=y
BR2_PACKAGE_SQUASHFS_LZ4=y
BR2_PACKAGE_SQUASHFS_LZMA=y
BR2_PACKAGE_SQUASHFS_LZO=y
BR2_PACKAGE_SQUASHFS_XZ=y
BR2_PACKAGE_FREESCALE_IMX=y
BR2_PACKAGE_UBOOT_TOOLS=y
BR2_PACKAGE_UBOOT_TOOLS_MKIMAGE=y
BR2_PACKAGE_LUAJIT=y
BR2_PACKAGE_LUAPOSIX=y
BR2_PACKAGE_LUA_RESTY_CORE=y
BR2_PACKAGE_LUA_RESTY_LRUCACHE=y
BR2_PACKAGE_LUA_RESTY_WEBSOCKET=y
BR2_PACKAGE_LIBSSH=y
BR2_PACKAGE_LIBSSH2=y
BR2_PACKAGE_LIBOPENSSL_BIN=y
BR2_PACKAGE_LIBSERIALPORT=y
BR2_PACKAGE_LIBUSB=y
BR2_PACKAGE_LIBUSB_COMPAT=y
BR2_PACKAGE_LIBXML2=y
BR2_PACKAGE_SPDLOG=y
BR2_PACKAGE_LIBCURL=y
BR2_PACKAGE_LIBCURL_CURL=y
BR2_PACKAGE_LIBFCGI=y
BR2_PACKAGE_LIBOPING=y
BR2_PACKAGE_LIBB64=y
BR2_PACKAGE_LINUX_PAM=y
BR2_PACKAGE_DHCP=y
BR2_PACKAGE_DHCP_CLIENT=y
BR2_PACKAGE_DROPBEAR=y
# BR2_PACKAGE_DROPBEAR_SMALL is not set
BR2_PACKAGE_DROPBEAR_WTMP=y
BR2_PACKAGE_DROPBEAR_LASTLOG=y
BR2_PACKAGE_ETHTOOL=y
BR2_PACKAGE_IPERF=y
BR2_PACKAGE_IPROUTE2=y
BR2_PACKAGE_IPTABLES=y
BR2_PACKAGE_IPUTILS=y
BR2_PACKAGE_LFTP=y
# BR2_PACKAGE_LFTP_CMD_MIRROR is not set
BR2_PACKAGE_LFTP_PROTO_FISH=y
BR2_PACKAGE_LFTP_PROTO_SFTP=y
BR2_PACKAGE_NETSNMP=y
# BR2_PACKAGE_NETSNMP_ENABLE_MIBS is not set
BR2_PACKAGE_NGINX=y
BR2_PACKAGE_NGINX_HTTP_SSL_MODULE=y
BR2_PACKAGE_NGINX_HTTP_V2_MODULE=y
BR2_PACKAGE_LUA_NGINX_MODULE=y
BR2_PACKAGE_NGX_DEVEL_KIT=y
BR2_PACKAGE_NTP=y
BR2_PACKAGE_NTP_NTP_KEYGEN=y
# BR2_PACKAGE_NTP_NTPD is not set
BR2_PACKAGE_NTP_NTPDATE=y
BR2_PACKAGE_NTP_NTPDC=y
BR2_PACKAGE_NTP_NTPTIME=y
BR2_PACKAGE_SOCAT=y
BR2_PACKAGE_TCPDUMP=y
BR2_PACKAGE_LOGROTATE=y
BR2_PACKAGE_RSYSLOG=y
BR2_PACKAGE_TAR=y
BR2_TARGET_ROOTFS_SQUASHFS=y
BR2_TARGET_ROOTFS_SQUASHFS4_LZMA=y
BR2_TARGET_ROOTFS_TAR_GZIP=y
```

## package/llvm-project/clang/Config.in.host
```kconfig
config BR2_PACKAGE_HOST_CLANG
	bool "host clang"
	depends on BR2_PACKAGE_LLVM_ARCH_SUPPORTS # llvm
	depends on BR2_HOST_GCC_AT_LEAST_7 # host-llvm
	select BR2_HOST_CMAKE_AT_LEAST_3_20 # cmake required version at least 3.20
	help
	  Clang is a C/C++, Objective C/C++ and OpenCL C front-end
	  for the LLVM compiler. The host build installs clang and
	  its tools, clang-format among them, into the host
	  directory.

	  http://clang.llvm.org

if BR2_PACKAGE_HOST_CLANG

config BR2_PACKAGE_HOST_CLANG_TOOLS_EXTRA
	bool "clang-tools-extra"
	help
	  Build the clang-tools-extra tools of the LLVM project
	  (clang-tidy, clang-include-fixer, ...) together with
	  host clang. clangd is not built.

	  https://clang.llvm.org/extra/

config BR2_PACKAGE_HOST_CLANG_TOOLS_ONLY
	bool "host clang tools only"
	# the per-package host directories keep the removed files
	depends on BR2_PER_PACKAGE_DIRECTORIES
	# packages that build against host clang or host llvm
	depends on !BR2_PACKAGE_LLVM
	depends on !BR2_PACKAGE_CLANG
	depends on !BR2_PACKAGE_COMPILER_RT
	depends on !BR2_PACKAGE_LIBCLC
	depends on !BR2_PACKAGE_SPIRV_LLVM_TRANSLATOR
	depends on !BR2_PACKAGE_MESA3D_LLVM
	depends on !BR2_PACKAGE_QT5TOOLS_QDOC_TOOL
	depends on !BR2_PACKAGE_HOST_LLD
	help
	  Keep only the clang and LLVM tools and their shared
	  libraries in the host directory (and so in the SDK): the
	  static libraries of host-llvm and host-clang, their CMake
	  package files and llvm-config are removed when the host
	  directory is finalized.

	  A package that builds against host clang or host llvm
	  (compiler-rt, libclc, mesa3d, qt5tools qdoc, lld, ...)
	  needs them; such a package hides this option, and a new
	  one needs to be added to this option's "depends on" list.

	  Needs per-package directories: the files are removed only
	  from the merged host directory, while each package's own
	  host directory keeps them, so a later rebuild of host
	  clang or of a package using it still finds them. Without
	  per-package directories they would be gone from the only
	  host directory until a clean build.

endif

comment "host clang needs host gcc >= 7"
	depends on BR2_PACKAGE_LLVM_ARCH_SUPPORTS
	depends on !BR2_HOST_GCC_AT_LEAST_7
```
